#include "app_oled12864.h"

/**************************************************************************************************
* 版本：V1.00
* 日期：2024-09-03
* 功能：OLED12864显示
* 更新：初始版本
* 作者：专业理工男
**************************************************************************************************/

//显示缓冲区，8行16列,128列向右偏移4列
u8 xdata DmaTxBuffer[8][132];
u8 xdata DmaRxBuffer[8][132];

bit	DmaTxFlag=0;
bit	DmaRxFlag=0;

/**************************************************************************************************
* 功能：OLED12864初始化
* 参数：无
* 描述：无
**************************************************************************************************/
void OLED12864_Init(void)
{
	//硬件I2C初始化
	I2C_S1 =0;      //I2C功能脚选择，00:P2.4,P2.3; 01:P1.5,P1.4; 11:P3.2,P3.3
    I2C_S0 =0;
	I2CCFG = 0xce;  //使能I2C主机模式
    I2CPSCR = 0x00; //MSSPEED[13:6]，配置速度162k
    I2CMSST = 0x00;	//关闭中断，处于待机状态
	
	//I2C DMA配置
	DMA_I2CT_STA = 0x00;
    DMA_I2CT_CFG = 0x80;	//bit7 1:Enable Interrupt
    DMA_I2CT_AMT = 0x03;	//设置传输总字节数(低8位)：n+1
    DMA_I2CT_AMTH = 0x00;	//设置传输总字节数(高8位)：n+1
    DMA_I2CT_TXAH = (u8)((u16)&DmaTxBuffer[0][0] >> 8);	//I2C发送数据存储地址
    DMA_I2CT_TXAL = (u8)((u16)&DmaTxBuffer[0][0]);
    DMA_I2CT_CR = 0x80;		//bit7 1:使能 I2CT_DMA, bit6 1:开始 I2CT_DMA

    DMA_I2CR_STA = 0x00;
    DMA_I2CR_CFG = 0x80;	//bit7 1:Enable Interrupt
    DMA_I2CR_AMT = 0x03;	//设置传输总字节数(低8位)：n+1
    DMA_I2CR_AMTH = 0x00;	//设置传输总字节数(高8位)：n+1
    DMA_I2CR_RXAH = (u8)((u16)&DmaRxBuffer[0][0] >> 8);	//I2C接收数据存储地址
    DMA_I2CR_RXAL = (u8)((u16)&DmaRxBuffer[0][0]);
    DMA_I2CR_CR = 0x81;		//bit7 1:使能 I2CT_DMA, bit5 1:开始 I2CT_DMA, bit0 1:清除 FIFO

    DMA_I2C_ST1 = 0x03;		//设置需要传输字节数(低8位)：n+1
    DMA_I2C_ST2 = 0x00;		//设置需要传输字节数(高8位)：n+1
	
	//OLED初始化配置
	Delay500ms();	//初始化之前的延时很重要！延长寿命！
	OLED_WrCmd(0xae);	//关闭oled面板
	OLED_WrCmd(0x00);	//设置低列地址
	OLED_WrCmd(0x10);	//设置高列地址
	OLED_WrCmd(0x40);	//设置映射RAM显示起始线(0x00~0x3F)
	OLED_WrCmd(0x81);	//设置对比度控制寄存器
	OLED_WrCmd(0xCF);	//设置SEG输出电流亮度
	OLED_WrCmd(0xa1);	//赛格/列映射     			0xa0左右反置 0xa1正常
	OLED_WrCmd(0xc8);	//设置“COM/Row扫描方向”		0xc0上下反置 0xc8正常
	OLED_WrCmd(0xa6);	//设置正常显示
	OLED_WrCmd(0xa8);	//设置复用比例(1 ~ 64)
	OLED_WrCmd(0x3f);	//1/64的责任
	OLED_WrCmd(0xd3);	//设置显示偏移移位映射RAM计数器(0x00~0x3F)
	OLED_WrCmd(0x00);	//不偏移
	OLED_WrCmd(0xd5);	//设置显示时钟分频比/振荡器频率
	OLED_WrCmd(0x80);	//设置分割比率，设置时钟为100帧/秒
	OLED_WrCmd(0xd9);	//设置预充电时期
	OLED_WrCmd(0xf1);	//设置预充电为15个时钟&放电为1个时钟
	OLED_WrCmd(0xda);	//设置com引脚硬件配置
	OLED_WrCmd(0x12);
	OLED_WrCmd(0xdb);	//设置vcomh
	OLED_WrCmd(0x40);	//设置VCOM取消选择级别
	OLED_WrCmd(0x20);	//设置页面寻址模式(0x00/0x01/0x02)
	OLED_WrCmd(0x02);	//
	OLED_WrCmd(0x8d);	//设置充电泵 使能/不使能
	OLED_WrCmd(0x14);	//设置(0 x10)禁用
	OLED_WrCmd(0xa4);	//禁用整个显示打开(0xa4/0xa5)
	OLED_WrCmd(0xa6);	//禁用逆显示开关(0xa6/a7) 
	OLED_WrCmd(0xaf);	//打开oled面板
	OLED_Fill(0xff);	//初始清屏
	OLED_Set_Pos(0,0);	//设置起始坐标
}

/**************************************************************************************************
* 功能：I2C写N个字节
* 参数：mode：0：命令，1：数据；number：数据个数
* 描述：无
**************************************************************************************************/
void WriteNbyte(u8 mode, u8 number)
{
    while(I2CMSST & 0x80);  //检查I2C控制器忙碌状态

    DmaTxFlag = 1;
    DmaTxBuffer[0][0] = OLED_ADDR;
    DmaTxBuffer[0][1] = mode;

    I2CMSST = 0x00;
    I2CMSCR = 0x89;             //set cmd //write_start_combo
    DMA_I2C_CR = 0x01;
    DMA_I2CT_AMT = number+1;    //设置传输总字节数(低8位)：number + 设备地址 + 存储地址
    DMA_I2CT_AMTH = 0x00;       //设置传输总字节数(高8位)：n+1
    DMA_I2C_ST1 = number+1;     //设置需要传输字节数(低8位)：number + 设备地址 + 存储地址
    DMA_I2C_ST2 = 0x00;         //设置需要传输字节数(高8位)：n+1
    DMA_I2CT_CR |= 0x40;        //bit7 1:使能 I2CT_DMA, bit6 1:开始 I2CT_DMA

    while(DmaTxFlag);           //DMA忙检测
    DMA_I2C_CR = 0x00;
}

/**************************************************************************************************
* 功能：OLED写数据
* 参数：dat：写入的数据
* 描述：无
**************************************************************************************************/
void OLED_WrDat(u8 dat)
{
	DmaTxBuffer[0][2] = dat;
	WriteNbyte(0x40,1);
}

/**************************************************************************************************
* 功能：OLED写命令
* 参数：无
* 描述：无
**************************************************************************************************/
void OLED_WrCmd(u8 cmd)
{
	DmaTxBuffer[0][2] = cmd;
	WriteNbyte(0x00,1);
}

/**************************************************************************************************
* 功能：OLED设置坐标 
* 参数：无
* 描述：无
**************************************************************************************************/
void OLED_Set_Pos(u8 x, u8 y)
{
	OLED_WrCmd((u8)(0xb0+y));
	OLED_WrCmd(((x&0xf0)>>4)|0x10);
	OLED_WrCmd((x&0x0f)|0x00);
}

/**************************************************************************************************
* 功能：OLED全屏  
* 参数：无
* 描述：无
**************************************************************************************************/
void OLED_Fill(uchar dat)
{
	uchar y,x;
	for(y=0;y<8;y++)
	{
		OLED_WrCmd((u8)(0xb0+y));
		OLED_WrCmd(0x00);
		OLED_WrCmd(0x10);
		for(x=0;x<X_WIDTH;x++)
		OLED_WrDat(dat);
	}
}

/**************************************************************************************************
* 功能：屏幕界面刷新   
* 参数：无
* 描述：无
**************************************************************************************************/
void Screen_Refresh(void)
{
	uchar i,j;
	
	for(i=0;i<8;i++)
	{
		OLED_WrCmd((u8)(0xb0+i));   //设置页地址（0~7）
		OLED_WrCmd(0x00);      		//设置显示位置—列低地址
		OLED_WrCmd(0x10);      		//设置显示位置—列高地址  
		
		for(j=4;j<132;j++)	OLED_WrDat(DmaTxBuffer[i][j]);		//显示数据向右偏移4
	}
}

/**************************************************************************************************
* 功能：8X16字符显示控制
* 参数：x,y:坐标以8个点为1个单位，text：显示的数据，mode：正显或反显
* 描述：以显示字符的左上角开始,x:行，y：列
**************************************************************************************************/
void Oled_Disp_8x16(uint8_t x,uint8_t y,uint8_t text,uint8_t mode)
{
	uint8_t j,k,l;										//j：字符码表位置，k字符上下段显示，l字符列显示
	
	if((text >= 0x20) && (text <= 0x7e))
	{
		j = text - 0x20;
		for(k = 0;k < 2; k++)
		{
			for(l = 0; l < 8; l++)						
			{
				if(mode == 0)
				{
					DmaTxBuffer[x+k][y*8+l+4] = ASCII_8x16[j][l+k*8];		//显示数据向右偏移4	
				}
				else
				{
					DmaTxBuffer[x+k][y*8+l+4] = ~ASCII_8x16[j][l+k*8];		//显示数据向右偏移4
				}
			}
		}
	}
}

/**************************************************************************************************
* 功能：寻找汉字位置
* 参数：dp：汉字地址
* 描述：返回汉字位置
**************************************************************************************************/
int16_t find_hanzi_pos(uint8_t *dp)
{
	uint16_t i;
	int16_t  pos = -1;

	for(i = 0; i < hz_Num; i++)
	{
		if ((dp[0] == hzIndex[i * 2]) && (dp[1] == hzIndex[i * 2 + 1]))
		{
			pos = i;
			break;
		}
	}

	return pos * 2 * HZWIDTH;
}

/**************************************************************************************************
* 功能：OLED显示一个汉字
* 参数：x,y:坐标以8个点为1个单位，text：显示的数据首地址，mode：正显或反显
* 描述：以显示字符的左上角开始,x:行，y：列
**************************************************************************************************/
void OLED_Disp_Chinese(uint8_t x,uint8_t y,uint8_t *text,uint8_t mode)
{
	int16_t pos,i,j;					//pos：汉字码表位置，i字符上下段显示，j字符列显示

	pos = find_hanzi_pos(text);			//寻找汉字位置
	
	if(pos >= 0)
	{
		for(i = 0;i < 2;i++)
		{
			for(j = 0;j < 16;j++)
			{
				if(mode == 0)
				{
					DmaTxBuffer[x+i][y*8+j+4] = hzdot[pos+j+i*16];
				}
				else
				{
					DmaTxBuffer[x+i][y*8+j+4] =~hzdot[pos+j+i*16];
				}
			}
		}
	}
}

/**************************************************************************************************
* 功能：OLED字符、汉字混合显示
* 参数：x,y:坐标以8x16为1个单位，text：显示的数据首地址，mode：正显或反显
* 描述：以显示字符的左上角开始,x:行，y：列
**************************************************************************************************/
void OLED_Disp(uint8_t x,uint8_t y,uint8_t *text,uint8_t mode)
{
	uint8_t i = 0;
	
	while(*text)
	{
		if(*text < 128)
		{
			Oled_Disp_8x16(x,(u8)(y+i),*text,mode);
			i++;
			text++;
		}
		else
		{
			OLED_Disp_Chinese(x,(u8)(y+i),text,mode);
			i+=2;
			text+=2;
		}
	}
}

/**************************************************************************************************
* 功能：清空缓冲区
* 参数：无
* 描述：无
**************************************************************************************************/
void Clear_Buff(void)
{
	uint16_t i,j;
	
	for(i=0;i<8;i++)
		for(j=4;j<132;j++)
		{
			DmaTxBuffer[i][j] = 0;
		}
}

/**************************************************************************************************
* 功能：填满缓冲区
* 参数：无
* 描述：无
**************************************************************************************************/
void Full_Buff(void)
{
	uint16_t i,j;
	
	for(i=0;i<8;i++)
		for(j=4;j<132;j++)
		{
			DmaTxBuffer[i][j] = 0xff;
		}
}

/**************************************************************************************************
* 功能：OLED显示一个16*16图标
* 参数：x,y:坐标以8个点为1个单位，text：显示的数据首地址
* 描述：以显示字符的左上角开始,x:行，y：列
**************************************************************************************************/
void OLED_Disp_BMP_16x16(uint8_t x,uint8_t y,uint8_t num)
{
	int16_t i,j;					//i字符上下段显示，j字符列显示
	
	for(i = 0;i < 2;i++)
	{
		for(j = 0;j < 16;j++)
		{
			DmaTxBuffer[x+i][y*8+j+4] = BMP_16x16[num][i*16+j];
		}
	}
}

/**************************************************************************************************
* 功能：方向图标显示
* 参数：x,y:坐标，num：像素块
* 描述：无
**************************************************************************************************/
void Direction_Icon(uint8_t x,uint8_t y,uint8_t num)
{
	uint8_t i;
	
	for(i=0;i<32;i++)
	{
		DmaTxBuffer[x][y*8+i] = BMP_32x32[num][i];
	}
	for(i=0;i<32;i++)
	{
		DmaTxBuffer[x+1][y*8+i] = BMP_32x32[num][32+i];
	}
	for(i=0;i<32;i++)
	{
		DmaTxBuffer[x+2][y*8+i] = BMP_32x32[num][64+i];
	}
	for(i=0;i<32;i++)
	{
		DmaTxBuffer[x+3][y*8+i] = BMP_32x32[num][96+i];
	}
}

/**************************************************************************************************
* 功能：I2C DMA中断函数
* 参数：无
* 描述：interrupt 60/61
**************************************************************************************************/
void I2C_DMA_Interrupt(void) interrupt 60
{
    if(DMA_I2CT_STA & 0x01)     //发送完成
    {
        DMA_I2CT_STA &= ~0x01;  //清除标志位
        DmaTxFlag = 0;
    }
    if(DMA_I2CT_STA & 0x04)     //数据覆盖
    {
        DMA_I2CT_STA &= ~0x04;  //清除标志位
    }

    if(DMA_I2CR_STA & 0x01)     //接收完成
    {
        DMA_I2CR_STA &= ~0x01;  //清除标志位
        DmaRxFlag = 0;
    }
    if(DMA_I2CR_STA & 0x02)     //数据丢弃
    {
        DMA_I2CR_STA &= ~0x02;  //清除标志位
    }
}

/**************************************************************************************************
* 功能：I2C 中断函数
* 参数：无
* 描述：无
**************************************************************************************************/
void I2C_Interrupt() interrupt 24
{
	I2CMSST &= ~0x40;       //I2C指令发送完成状态清除

	if(DMA_I2C_CR & 0x04)   //ACKERR
	{
		DMA_I2C_CR &= ~0x04;  //发数据后收到NAK
	}
}
